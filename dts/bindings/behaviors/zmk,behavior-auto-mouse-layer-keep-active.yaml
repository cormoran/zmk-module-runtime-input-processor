## dts/bindings/behaviors/zmk,behavior-auto-mouse-layer-keep-active.yaml
```yaml
# Copyright (c) 2026 The ZMK Contributors
# SPDX-License-Identifier: MIT

description: |
  Behavior to keep the auto mouse layer active while the key is held.
  When this behavior is pressed, it prevents the auto mouse layer from 
  automatically deactivating due to inactivity timeout.

compatible: "zmk,behavior-auto-mouse-layer-keep-active"

include: behavior.yaml

properties:
  "#binding-cells":
    const: 0
```

## dts/bindings/behaviors/zmk,behavior-input-processor-auto-mouse-keep-active.yaml
```yaml
# Copyright (c) 2026 The ZMK Contributors
# SPDX-License-Identifier: MIT

description: |
  Behavior to keep auto-mouse layer active while a key is held.
  When this behavior is pressed, it prevents the auto-mouse layer from
  automatically deactivating. This is useful for keeping the mouse layer
  active while performing complex mouse operations.

compatible: "zmk,behavior-input-processor-auto-mouse-keep-active"

include: zero_param.yaml


properties:
  processor-name:
    type: string
    required: true
    description: Name of the runtime input processor with auto-mouse enabled
```

## dts/bindings/behaviors/zmk,behavior-input-processor-axis-snap.yaml
```yaml
# Copyright (c) 2026 The ZMK Contributors
# SPDX-License-Identifier: MIT

description: |
  Behavior to temporarily enable axis snapping while a key is held.
  Useful for locking movement to a specific axis during text selection.
  
  Parameters:
  - param1: Snap mode (0=none, 1=X, 2=Y)
  - param2: Threshold for unlocking snap

compatible: "zmk,behavior-input-processor-axis-snap"

include: two_param.yaml

properties:
  processor-name:
    type: string
    required: true
    description: Name of the runtime input processor to modify

  timeout-ms:
    type: int
    default: 1000
    description: Decay timeout in milliseconds
```

## dts/bindings/behaviors/zmk,behavior-input-processor-keybind-temp-config.yaml
```yaml
# Copyright (c) 2026 The ZMK Contributors
# SPDX-License-Identifier: MIT

description: |
  Behavior for temporarily changing keybind processor configuration.
  When pressed, applies temporary configuration. When released, restores original settings.

compatible: "zmk,behavior-input-processor-keybind-temp-config"

include: ../zmk,behavior-key-toggle.yaml

properties:
  processor-name:
    type: string
    required: true
    description: Name of the keybind processor to configure

  tick:
    type: int
    description: Temporary tick value (movement units per activation)

  degree-offset:
    type: int
    description: Temporary degree offset (0-359)

  wait-ms:
    type: int
    description: Temporary wait delay (milliseconds)

  tap-ms:
    type: int
    description: Temporary tap duration (milliseconds)
```

## dts/bindings/behaviors/zmk,behavior-input-processor-temp-config.yaml
```yaml
# Copyright (c) 2026 The ZMK Contributors
# SPDX-License-Identifier: MIT

description: |
  Behavior to temporarily change input processor configuration while a key is held.
  Useful for temporarily changing DPI/speed of pointing devices.

compatible: "zmk,behavior-input-processor-temp-config"

include: zero_param.yaml


properties:
  processor-name:
    type: string
    required: true
    description: Name of the runtime input processor to modify

  scale-multiplier:
    type: int
    description: Temporary scaling multiplier (0 = no change)
    default: 1

  scale-divisor:
    type: int
    description: Temporary scaling divisor (0 = no change)
    default: 1

  rotation-degrees:
    type: int
    description: Temporary rotation angle in degrees (0 = no change)
    default: 0
```

## dts/bindings/behaviors/zmk,behavior-input-processor-temp-layer-keep-active.yaml
```yaml
# Copyright (c) 2026 The ZMK Contributors
# SPDX-License-Identifier: MIT

description: |
  Behavior to keep temp-layer layer active while a key is held.
  When this behavior is pressed, it prevents the temp-layer layer from
  automatically deactivating. This is useful for keeping the mouse layer
  active while performing complex mouse operations.

compatible: "zmk,behavior-input-processor-temp-layer-keep-active"

include: zero_param.yaml


properties:
  processor-name:
    type: string
    required: true
    description: Name of the runtime input processor with temp-layer enabled
```

## dts/bindings/input_processors/zmk,input-processor-auto-mouse-layer.yaml
```yaml
# Copyright (c) 2026 The ZMK Contributors
# SPDX-License-Identifier: MIT

description: |
  Input Processor for automatically enabling a mouse layer when pointer movement
  is detected, with configurable idle time requirements and automatic deactivation.

compatible: "zmk,input-processor-auto-mouse-layer"

include: base.yaml

properties:
  layer:
    type: int
    required: true
    description: Layer index to activate when pointer input is detected

  require-prior-idle-ms:
    type: int
    required: false
    default: 0
    description: |
      Time in milliseconds that must pass after the last keystroke before the 
      layer can be activated. Set to 0 to disable this check.

  time-to-max-ms:
    type: int
    required: false
    default: 600
    description: |
      Time in milliseconds to wait after pointer input stops before deactivating 
      the layer. Set to 0 to disable automatic deactivation.

  "#input-processor-cells":
    const: 0
```

## dts/bindings/input_processors/zmk,input-processor-keybind.yaml
```yaml
# Copyright (c) 2026 The ZMK Contributors
# SPDX-License-Identifier: MIT

description: |
  Runtime configurable input processor that converts input events to key press events.
  Supports 1-8 behaviors with 2D dimension separation and degree offset rotation.
  Special thanks to https://github.com/zettaface/zmk-input-processor-keybind for the original concept.

compatible: "zmk,input-processor-keybind"

include: base.yaml

properties:
  processor-label:
    type: string
    required: true
    description: |
      Short label for the input processor (max 8 chars for BLE compatibility).
      Used to identify the processor in runtime configuration.

  type:
    type: int
    default: 0x02  # INPUT_EV_REL
    description: Event type to process

  x-codes:
    type: array
    required: true
    description: X-axis input codes to process

  y-codes:
    type: array
    required: true
    description: Y-axis input codes to process

  bindings:
    type: phandle-array
    description: |
      List of behaviors to trigger (1-8 behaviors supported).
      The 2D dimension is split into equal angular sections (360/count degrees each).
      Behaviors are assigned in clockwise order starting from the positive Y axis (up).
      Example with 4 behaviors: [0]=up, [1]=right, [2]=down, [3]=left

  tick:
    type: int
    default: 10
    description: |
      Movement units needed per activation (higher = less sensitive).
      Once tick threshold is reached, a behavior is triggered and accumulation resets.

  degree-offset:
    type: int
    default: 0
    description: |
      Degree offset to rotate the 2D dimension split points (0-359).
      Example: offset=0 means first behavior triggers for upward movement (Y>0).
      offset=90 rotates split points 90 degrees clockwise.

  track-remainders:
    type: boolean
    description: Track remainders for movement accumulation (enabled if present)

  wait-ms:
    type: int
    default: 0
    description: Delay before next activation (milliseconds)

  tap-ms:
    type: int
    default: 20
    description: Press-to-release timing for key taps (milliseconds)

  active-layers:
    type: int
    default: 0
    description: |
      Bitmask of layers where processor should be active (0 = all layers).
      Each bit represents a layer: bit 0 = layer 0, bit 1 = layer 1, etc.
```

## west.yml
```yaml
# manifest to be imported by dependents (if dependency exists)
manifest:
  self:
    import: west/west-dependency/west-dependency.yml
  # Please edit west/west-dependency/west-dependency.yml to change dependencies
```
