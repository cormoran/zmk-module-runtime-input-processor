## Kconfig
```kconfig
config ZMK_RUNTIME_INPUT_PROCESSOR
    bool "Enable runtime input processor feature"
    select ZMK_CUSTOM_SETTINGS

if ZMK_RUNTIME_INPUT_PROCESSOR

config ZMK_RUNTIME_INPUT_PROCESSOR_INERTIA_WINDOW_SLICES
    int "Number of time slices in an inertia measurement window"
    range 4 254
    default 64

config ZMK_RUNTIME_INPUT_PROCESSOR_INERTIA_BUCKETS
    int "Inertia rolling buffer bucket count"
    range 6 256
    default 66
    help
      Must be at least the window slice count plus two. Each processor keeps
      five rolling buffers, so increasing this value uses more RAM.

config ZMK_RUNTIME_INPUT_PROCESSOR_INERTIA_REVERSE_EXIT_MIN
    int "Minimum reverse counts that stop inertia"
    range 1 65535
    default 3

config ZMK_RUNTIME_INPUT_PROCESSOR_INERTIA_REVERSE_EXIT_MAX
    int "Maximum reverse counts that stop inertia"
    range 1 65535
    default 12

config ZMK_RUNTIME_INPUT_PROCESSOR_STUDIO_RPC
    bool "Enable runtime input processor custom Studio RPC"
    depends on ZMK_STUDIO

config ZMK_RUNTIME_INPUT_PROCESSOR_NAME_MAX_LEN
    int "Maximum length of runtime input processor names"
    default 8

config ZMK_RUNTIME_INPUT_PROCESSOR_TEST
    bool "Enable test-only hooks for the persisted-settings boot-apply path"
    help
      Compiles in zmk_input_processor_runtime_test_apply_persisted_settings(),
      which lets a test synchronously re-run the settings boot-apply logic
      instead of waiting on the real SYS_INIT delay. Not for production use.

config ZMK_RENODE_STUDIO_UART_TRANSPORT
    bool "Studio RPC UART transport for Renode emulation testing"
    depends on ZMK_RUNTIME_INPUT_PROCESSOR_STUDIO_RPC
    select SERIAL
    select RING_BUFFER
    select UART_INTERRUPT_DRIVEN
    help
      Adds a Renode-only Studio RPC UART transport that is selected without
      a USB or BLE endpoint. This is solely for the module's hardware-free
      test build; do not enable it in firmware flashed to real hardware.

endif
```

## dts/bindings/input_processors/zmk,input-processor-runtime.yaml
```yaml
# Copyright (c) 2026 The ZMK Contributors
# SPDX-License-Identifier: MIT

description: |
  Runtime configurable input processor for ZMK.
  Supports runtime configuration of scaling and rotation parameters.

compatible: "zmk,input-processor-runtime"

include: base.yaml

properties:
  processor-label:
    type: string
    required: true
    description: |
      Short label for the input processor (max 8 chars for BLE compatibility).
      Used to identify the processor in runtime configuration.

  type:
    type: int
    default: 0x02  # INPUT_EV_REL
    description: Event type to process

  x-codes:
    type: array
    required: true
    description: X-axis input codes to process

  y-codes:
    type: array
    required: true
    description: Y-axis input codes to process

  scale-multiplier:
    type: int
    default: 1
    description: Initial scaling multiplier

  scale-divisor:
    type: int
    default: 1
    description: Initial scaling divisor

  rotation-degrees:
    type: int
    default: 0
    description: Initial rotation angle in degrees

  track-remainders:
    type: boolean
    description: Track remainders for scaling operations (enabled if present)

  temp-layer-transparent-behavior:
    type: phandle
    description: |
      Behavior to compare against for transparent detection (typically &trans).
      Used for efficient temp-layer layer deactivation logic.

  temp-layer-kp-behavior:
    type: phandle
    description: |
      Behavior to compare against for key press detection (typically &kp).
      Used to identify modifier keys for temp-layer layer deactivation logic.

  temp-layer-keep-keycodes:
    type: array
    description: |
      List of modifier keycodes that should not deactivate the temp-layer layer.
      Typically includes LCTRL, LSHIFT, LALT, LGUI, RCTRL, RSHIFT, RALT, RGUI.

  temp-layer-enabled:
    type: boolean
    description: If present, temp-layer layer is enabled by default

  temp-layer:
    type: int
    default: 0
    description: Default target layer ID for temp-layer

  temp-layer-activation-delay-ms:
    type: int
    default: 100
    description: Default delay before activating temp-layer layer (milliseconds)

  temp-layer-deactivation-delay-ms:
    type: int
    default: 500
    description: Default delay before deactivating temp-layer layer after input stops (milliseconds)

  active-layers:
    type: int
    default: 0
    description: |
      Bitmask of layers where processor should be active (0 = all layers).
      Each bit represents a layer: bit 0 = layer 0, bit 1 = layer 1, etc.
      If at least one specified layer is active, the processor works.

  axis-snap-mode:
    type: int
    default: 0
    description: |
      Axis snapping mode: 0 = none, 1 = snap to X axis, 2 = snap to Y axis.
      When enabled, movement is locked to the selected axis unless threshold is exceeded.

  axis-snap-threshold:
    type: int
    default: 100
    description: |
      Threshold for axis snap unlock. When cross-axis movement exceeds this value
      within the timeout window, the snap lock is released.

  axis-snap-timeout-ms:
    type: int
    default: 1000
    description: |
      Time window (in milliseconds) for checking if cross-axis movement exceeds threshold.
      If threshold is not exceeded within this time, the snap lock window resets.

  xy-to-scroll-enabled:
    type: boolean
    description: If present, XY to scroll conversion is enabled

  xy-swap-enabled:
    type: boolean
    description: If present, swap X and Y axis values

  x-invert:
    type: boolean
    description: If present, invert X axis values (positive becomes negative and vice versa)

  y-invert:
    type: boolean
    description: If present, invert Y axis values (positive becomes negative and vice versa)

  inertia-enabled:
    type: boolean
    description: Enable inertia for this processor. Can also be changed in Studio.

  inertia-window-ms:
    type: int
    default: 200
    description: |
      Sliding time window used to detect rapid input and measure input totals
      after inertia starts, in milliseconds. Reports spanning multiple time
      slices are distributed proportionally across them.

  inertia-interval-ms:
    type: int
    default: 20
    description: Interval between inertia events after it starts, in milliseconds.

  inertia-threshold:
    type: int
    default: 12
    description: |
      Same-direction output amount after scaling that starts inertia inside
      one time window. Subsequent speed measurements,
      reverse movement, and generated inertia use input before scaling;
      generated output is then scaled.

  inertia-decay-percent:
    type: int
    default: 8
    description: |
      Percentage of retained inertia speed removed after each output
      interval without new physical input. Decay multiplies the remaining
      speed, producing an exponential tail. Zero holds speed and 100 stops
      output after one further interval.

  inertia-fast-threshold:
    type: int
    default: 20
    description: |
      Second-stage input amount after scaling within the inertia window.
      Zero disables fast output. Once crossed, fast output stays active until
      that inertia run ends.

  inertia-fast-output-percent:
    type: int
    default: 200
    description: |
      Percentage applied to synthetic inertia output in the second stage.
      Valid values are 100 through 1000; 200 doubles the output.
```
